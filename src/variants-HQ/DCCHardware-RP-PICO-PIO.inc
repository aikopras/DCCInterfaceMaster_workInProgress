// File: DCCHardware-RP-PICO-PIO.h
//
// The Arduino IDE can not (yet??) compile PIO assemby code itself. 
// Therefore we need an offline tool, to compile that assembly code 
// and embed the resulting machine code into our Arduino sketch.
// That online tool can be found on: https://wokwi.com/tools/pioasm
//
// For this specific program, we used the PIO assembly code below
//
// The code shows two state machines: one for the DCC PIN and one
// for the AUX PIN. The DCC pin has a DCC signal; the duration of
// each bit is taken from the FIFO / osr. 
// The DCC signal taken from the FIFO may include the value 0
// (0x00000000), which marks the start of a new packet. Upon 
// reception of this marker, an interrupt is raised which starts
// the second state machine. This second state machine generates a 
// railcom cutout, and stops until it receives another interrupt.
// 

/*
.program dccPulseGenerator
; State machine frequency: 1 MHz (1 µs per instruction)
; autopull is enabled
; OSR layout (LSB → MSB):
; bit 0: levelA
; bits 1..15: durationA
; bit 16: levelB
; bits 17..31: durationB
; 0x00000000: Start of new packet marker

start:
    pull                 ; 32-bit symbol from FIFO -> OSR
    mov x, osr           ; all 32 bits in x
    jmp !x start_Packet  ; if x == 0 => Packet start Marker

    ; --- first part: levelA / durationA ---
    out pins, 1          ; bit 0 -> output pin (levelA)
    out x, 15            ; bits 1..15 -> X (durationA)
    nop [3]              ; compensation to make loop A and B equally long
loop_A:
    jmp x-- loop_A       ; wait for durationA
 
    ; --- second part: levelB / durationB ---
    out pins, 1          ; bit 16 -> output pin (levelB)
    out x, 15            ; bits 17..31 -> X (durationB)
loop_B:
    jmp x-- loop_B       ; wait for durationB
    jmp start            ; bit is done

start_Packet:            ; 0x00000000 => A new packet started
    irq 0                ; Inform the other SM  
    out x, 32            ; shift all bits out of osr
    jmp start            ; marker is done


.program railcomCutOut 
    wait 1 irq 0  [1]    ; Wait for start of a new DCC packet
    nop [31]             ; 32us extra delay
    set pins 1           ; pin high
    set x, 16            ; 17 iterations
loop_cutout:    
    nop [24]             ; 25us delay
    jmp x-- loop_cutout  ; 26 * 17 = 442us
    set pins 0           ; pin low after 444us

*/


// -------------------------------------------------- //
// This file is autogenerated by pioasm; do not edit! //
// -------------------------------------------------- //

#pragma once

#if !PICO_NO_HARDWARE
#include "hardware/pio.h"
#endif

// ----------------- //
// dccPulseGenerator //
// ----------------- //

#define dccPulseGenerator_wrap_target 0
#define dccPulseGenerator_wrap 13

static const uint16_t dccPulseGenerator_program_instructions[] = {
            //     .wrap_target
    0x80a0, //  0: pull   block                      
    0xa027, //  1: mov    x, osr                     
    0x002b, //  2: jmp    !x, 11                     
    0x6001, //  3: out    pins, 1                    
    0x602f, //  4: out    x, 15                      
    0xa342, //  5: nop                           [3] 
    0x0046, //  6: jmp    x--, 6                     
    0x6001, //  7: out    pins, 1                    
    0x602f, //  8: out    x, 15                      
    0x0049, //  9: jmp    x--, 9                     
    0x0000, // 10: jmp    0                          
    0xc000, // 11: irq    nowait 0                   
    0x6020, // 12: out    x, 32                      
    0x0000, // 13: jmp    0                          
            //     .wrap
};

#if !PICO_NO_HARDWARE
static const struct pio_program dccPulseGenerator_program = {
    .instructions = dccPulseGenerator_program_instructions,
    .length = 14,
    .origin = -1,
};

static inline pio_sm_config dccPulseGenerator_program_get_default_config(uint offset) {
    pio_sm_config c = pio_get_default_sm_config();
    sm_config_set_wrap(&c, offset + dccPulseGenerator_wrap_target, offset + dccPulseGenerator_wrap);
    return c;
}
#endif

// ------------- //
// railcomCutOut //
// ------------- //

#define railcomCutOut_wrap_target 0
#define railcomCutOut_wrap 6

static const uint16_t railcomCutOut_program_instructions[] = {
            //     .wrap_target
    0x21c0, //  0: wait   1 irq, 0               [1] 
    0xbf42, //  1: nop                           [31]
    0xe001, //  2: set    pins, 1                    
    0xe030, //  3: set    x, 16                      
    0xb842, //  4: nop                           [24]
    0x0044, //  5: jmp    x--, 4                     
    0xe000, //  6: set    pins, 0                    
            //     .wrap
};

#if !PICO_NO_HARDWARE
static const struct pio_program railcomCutOut_program = {
    .instructions = railcomCutOut_program_instructions,
    .length = 7,
    .origin = -1,
};

static inline pio_sm_config railcomCutOut_program_get_default_config(uint offset) {
    pio_sm_config c = pio_get_default_sm_config();
    sm_config_set_wrap(&c, offset + railcomCutOut_wrap_target, offset + railcomCutOut_wrap);
    return c;
}
#endif



